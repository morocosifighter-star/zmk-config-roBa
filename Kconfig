## Kconfig
```kconfig
config ZMK_BEHAVIOR_LAYER_OFF
    bool
    default y
    depends on !ZMK_SPLIT || ZMK_SPLIT_ROLE_CENTRAL

config ZMK_BEHAVIOR_LHT
    bool
    default y
    depends on !ZMK_SPLIT || ZMK_SPLIT_ROLE_CENTRAL
```

## dts/bindings/behaviors/zmk,behavior-layer-off.yaml
```yaml
description: Deactivate one specific layer
compatible: "zmk,behavior-layer-off"
include: one_param.yaml
```

## dts/bindings/behaviors/zmk,behavior-lht.yaml
```yaml
description: Layer on press, tap key on release
description: |
  param1 = layer, param2 = keycode
compatible: "zmk,behavior-lht"
include: two_param.yaml
```
